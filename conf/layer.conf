## conf/layer.conf
```bitbake
# We have a conf and classes directory, add to BBPATH
BBPATH .= ":${LAYERDIR}"

# We have recipes-* directories, add to BBFILES
BBFILES += "${LAYERDIR}/recipes-*/*/*.bb \
            ${LAYERDIR}/recipes-*/*/*.bbappend"

BBFILE_COLLECTIONS += "meta-snake"
BBFILE_PATTERN_meta-snake = "^${LAYERDIR}/"
BBFILE_PRIORITY_meta-snake = "6"

LAYERDEPENDS_meta-snake = "core"
LAYERSERIES_COMPAT_meta-snake = "styhead"
```
